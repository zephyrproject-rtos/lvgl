## zephyr/Kconfig.input
```kconfig
# Copyright (c) 2018-2019 Jan Van Winkel <jan.van_winkel@dxplore.eu>
# Copyright (c) 2020 Teslabs Engineering S.L.
# SPDX-License-Identifier: Apache-2.0

menu "Input device settings"


choice LV_Z_POINTER_DRIVER
	prompt "Pointer input driver"
	default LV_Z_POINTER_NONE
	help
	  Specify the lvgl pointer driver implementation.

	config LV_Z_POINTER_NONE
	  bool "Disable lvgl pointer"

	config LV_Z_POINTER_INPUT
	  bool "Input Subsystem"
	  depends on INPUT
	  select LV_Z_POINTER

	config LV_Z_POINTER_KSCAN
	  bool "Keyboard scan"
	  depends on KSCAN
	  select LV_Z_POINTER


endchoice

config LV_Z_POINTER
	bool

if LV_Z_POINTER

config LV_Z_POINTER_DRIVER_MSGQ_COUNT
	int "Pointer message queue count maximum"
	default 10
	help
	  Maximum number of items in the pointer message queue.

config LV_Z_POINTER_DRIVER_SWAP_XY
	bool "Swap keyboard scan X,Y axes"
	help
	  Swap pointer X,Y axes. This option can be used to align
	  coordinates with the display.

config LV_Z_POINTER_DRIVER_INVERT_X
	bool "Invert keyboard scan X axis"
	help
	  Invert pointer X axis. This option can be used to align
	  coordinates with the display.

config LV_Z_POINTER_DRIVER_INVERT_Y
	bool "Invert keyboard scan Y axis"
	help
	  Invert pointer scan Y axis. This option can be used to align
	  coordinates with the display.

endif # LV_Z_POINTER

endmenu
```
